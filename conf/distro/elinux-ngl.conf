## conf/distro/elinux-ngl.conf
```bitbake
require conf/distro/poky.conf

# NGL specific derivations
DISTRO = "elinux-ngl"
DISTRO_NAME = "Network Grade Linux"


# Release flags
DISTRO_CODENAME = "phoenix"
NGL_BRANCH = "master"
NGLVERSION = "1.0.0"
# switch  devel/release
NGLRELEASETYPE ?= "ngldevelopment"
#NGLRELEASETYPE ?= "nglrelease"
OVERRIDES .= ":${NGLRELEASETYPE}"
#

#for development
DISTRO_VERSION_ngldevelopment := "${NGLVERSION}+snapshot-${DATE}"
NGL_APP_REVISION_ngldevelopment = "${AUTOREV}"
NGL_DEFAULT_REVISION_ngldevelopment = "${AUTOREV}"

#for release
DISTRO_VERSION_nglrelease := "${NGLVERSION}"
DISTRO_BRANCH_VERSION_TAG = "${DISTRO_CODENAME}/${@'${DISTRO_VERSION}'.replace('+snapshot-${DATE}','')}"
NGL_APP_REVISION_nglrelease := "refs/tags/${DISTRO_BRANCH_VERSION_TAG}"
NGL_DEFAULT_REVISION_nglrelease := "refs/tags/${DISTRO_BRANCH_VERSION_TAG}"


# SDK
SDK_VENDOR = "-nglsdk"
SDK_VERSION := "${@'${DISTRO_VERSION}'.replace('snapshot-${DATE}','snapshot')}"

# SDKPATH is the folder where the SDK is going to be installed
# Due to an issue with the qt5 environment (see SPEC-1667),
# we add DEFAULTTUNE to the SDKPATH to mitigate the issue.
SDKPATH = "/opt/ngl-sdk/${SDK_VERSION}-${DEFAULTTUNE}"


MAINTAINER = "NGL <gokulraj.k@outlook.com>"

TARGET_VENDOR = "-ngl"

# Override these in poky based distros
NGL_DEFAULT_DISTRO_FEATURES = "largefile systemd pam bluetooth bluez5 3g"
POKY_DEFAULT_DISTRO_FEATURES := "${NGL_DEFAULT_DISTRO_FEATURES}"
OVERRIDES .= ":${DISTRO_CODENAME}"

QEMU_TARGETS ?= "arm aarch64 i386 x86_64"
# Other QEMU_TARGETS "mips mips64 mips64el ppc sh4"

PREMIRRORS ??= "\
bzr://.*/.*   http://downloads.yoctoproject.org/mirror/sources/ \n \
cvs://.*/.*   http://downloads.yoctoproject.org/mirror/sources/ \n \
git://.*/.*   http://downloads.yoctoproject.org/mirror/sources/ \n \
gitsm://.*/.* http://downloads.yoctoproject.org/mirror/sources/ \n \
hg://.*/.*    http://downloads.yoctoproject.org/mirror/sources/ \n \
osc://.*/.*   http://downloads.yoctoproject.org/mirror/sources/ \n \
p4://.*/.*    http://downloads.yoctoproject.org/mirror/sources/ \n \
svn://.*/.*   http://downloads.yoctoproject.org/mirror/sources/ \n"
 
MIRRORS =+ "\
ftp://.*/.*      http://downloads.yoctoproject.org/mirror/sources/ \n \
http://.*/.*     http://downloads.yoctoproject.org/mirror/sources/ \n \
https://.*/.*    http://downloads.yoctoproject.org/mirror/sources/ \n"

# The CONNECTIVITY_CHECK_URI's are used to test whether we can succesfully
# fetch from the network (and warn you if not). To disable the test set
# the variable to be empty.
# Git example url: git://git.yoctoproject.org/yocto-firewall-test;protocol=git;rev=HEAD
CONNECTIVITY_CHECK_URIS ?= ""

PREFERRED_PROVIDER_udev ?= "systemd"
PREFERRED_PROVIDER_udev-utils ?= "systemd"

VIRTUAL-RUNTIME_init_manager = "systemd"
VIRTUAL-RUNTIME_initscripts = ""

# network manager to use (possible values: systemd, connman)
VIRTUAL-RUNTIME_net_manager = "connman" 

DISTRO_FEATURES_APPEND = " "
DISTRO_FEATURES_remove = "x11"
DISTRO_FEATURES_BACKFILL_CONSIDERED = "sysvinit pulseaudio"

# Prefer GStreamer 1.14.x by default
PREFERRED_VERSION_gstreamer1.0              ?= "1.14.%"
PREFERRED_VERSION_gstreamer1.0-plugins-bad  ?= "1.14.%"
PREFERRED_VERSION_gstreamer1.0-plugins-base ?= "1.14.%"
PREFERRED_VERSION_gstreamer1.0-plugins-good ?= "1.14.%"
PREFERRED_VERSION_gstreamer1.0-plugins-ugly ?= "1.14.%"
PREFERRED_VERSION_gstreamer1.0-libav        ?= "1.14.%"
PREFERRED_VERSION_gstreamer1.0-omx          ?= "1.14.%"

# Prefer libjpeg-turbo
PREFERRED_PROVIDER_jpeg = "libjpeg-turbo"

# using multiple BSP layers causes dangling bbappends in meta-ngl-bsp
# turn it into a warning
#BB_DANGLINGAPPENDS_WARNONLY = "1"

# Not yet upstreamed; should be submitted.
SECURITY_CFLAGS_pn-qtwebengine = "${SECURITY_NO_PIE_CFLAGS}"

#Redefined USER_CLASSES
#Disable prelink. It is unmaintained and likely will go away.
#default: USER_CLASSES ?= "buildstats image-mklibs image-prelink"
USER_CLASSES = "buildstats image-mklibs"

# Generic qemu and qemuboot (runqemu) enhancements
# check qemuboot.bbclass
# - use 2G RAM by default
QB_MEM ?= "-m 2048"
# use pulseaudio on the host side - off as qemu-native is built with alsa
#QB_AUDIO_DRV = "pa"
# expose a virtual 'hda' sound card to the guest (arm/aarch64/x86-64)
QB_AUDIO_OPT = "-soundhw hda"

# Board templates can add extra IMAGE_FSTYPES through this.
# It is added (late) through the NGL image recipes.
#NGL_EXTRA_IMAGE_FSTYPES ??= ""
#NGL_EXTRA_INITRAMFS_FSTYPES ??= ""
#
# Default IMAGE FSTYPES compressed tarball + ext4.xz
#NGL_DEFAULT_IMAGE_FSTYPES ?= "tar.xz ${@bb.utils.contains('DISTRO_FEATURES', 'NGLCI', 'ext4.xz', 'ext4', d)}"
#NGL_DEFAULT_INITRAMFS_FSTYPES ?= "ext4.gz"

# DEFAULT IMAGE_FSTYPES for NGL (no - BSPs should not set this)
#
#IMAGE_FSTYPES := "${NGL_DEFAULT_IMAGE_FSTYPES} ${NGL_EXTRA_IMAGE_FSTYPES}"
#INITRAMFS_FSTYPES := "${NGL_DEFAULT_INITRAMFS_FSTYPES} ${NGL_EXTRA_INITRAMFS_FSTYPES}"
#
# THE FUTURE is 'wic'
# IMAGE_FSTYPES_append = " wic"

# Fix for rpm metadata clash between nativesdk-cmake and nativesdk-qtbase-tools
# (revalidate after 2017-10-15, 2018-06-12: still required)
DIRFILES_pn-nativesdk-cmake = "1"
```

## conf/distro/elinux.conf
```bitbake
DISTRO = "elinux"
DISTRO_NAME = "Embedded Linux Yocto"
DISTRO_VERSION = "1.0"
SDK_VENDOR = "-elinuxsdk"
SDK_VERSION := "${DISTRO_VERSION}"

MAINTAINER = "Poky <poky@yoctoproject.org>"

TARGET_VENDOR = "-elinux"

LOCALCONF_VERSION = "1"
LAYER_CONF_VERSION ?= "6"

DISTRO_FEATURES_append = ""

#DISTRO_FEATURES_DEFAULT = "alsa argp bluetooth ext2 largefile pcmcia usbgadget usbhost wifi xattr nfs pci x11"
DISTRO_FEATURES_DEFAULT = "alsa usbgadget usbhost wifi"

VIRTUAL-RUNTIME_dev_manager ?= "busybox-mdev"
VIRTUAL-RUNTIME_init_manager ?= "sysvinit"
VIRTUAL-RUNTIME_initscripts ?= "initscripts"

SDK_NAME = "${DISTRO}-${PNAME}-${TCLIBC}-${SDK_ARCH}-${TARGET_ARCH}"
SDKPATH = "/opt/${DISTRO}/${SDK_VERSION}"

TOOLCHAIN_OUTPUTNAME ?= "${SDK_NAME}-toolchain-${SDK_VERSION}_${MNAME}"

EXTRAOPKGCONFIG = "poky-feed-config-opkg"

# set the minimal ELINA feature set to use dlt-daemon as default
# for reference please check: https://confluence.harman.com/confluence/display/PFINTEG/Configuration+of+ELINA+Platform+Features
ELINUX_PLATFORM_FEATURES ?= ""
ELINUX_PLATFORM_FEATURES_append = " dlt "

# Override these in poky based distros to modify DISTRO_EXTRA_R*
POKY_DEFAULT_EXTRA_RDEPENDS = "packagegroup-core-boot"
POKY_DEFAULT_EXTRA_RRECOMMENDS = "kernel-module-af-packet"

DISTRO_EXTRA_RDEPENDS += " ${POKY_DEFAULT_EXTRA_RDEPENDS}"
DISTRO_EXTRA_RRECOMMENDS += " ${POKY_DEFAULT_EXTRA_RRECOMMENDS}"

POKYQEMUDEPS = "${@base_contains("INCOMPATIBLE_LICENSE", "GPLv3", "", "qemu-config",d)}"
DISTRO_EXTRA_RDEPENDS_append_qemuarm = " ${POKYQEMUDEPS}"
DISTRO_EXTRA_RDEPENDS_append_qemumips = " ${POKYQEMUDEPS}"
DISTRO_EXTRA_RDEPENDS_append_qemuppc = " ${POKYQEMUDEPS}"
DISTRO_EXTRA_RDEPENDS_append_qemux86 = " ${POKYQEMUDEPS}"
DISTRO_EXTRA_RDEPENDS_append_qemux86-64 = " ${POKYQEMUDEPS}"

TCLIBCAPPEND = ""

QEMU_TARGETS ?= "arm i386 mips mipsel ppc x86_64"
# Other QEMU_TARGETS "mips64 mips64el sh4"

PREMIRRORS ??= "\
bzr://.*/.*   http://downloads.yoctoproject.org/mirror/sources/ \n \
cvs://.*/.*   http://downloads.yoctoproject.org/mirror/sources/ \n \
git://.*/.*   http://downloads.yoctoproject.org/mirror/sources/ \n \
gitsm://.*/.* http://downloads.yoctoproject.org/mirror/sources/ \n \
hg://.*/.*    http://downloads.yoctoproject.org/mirror/sources/ \n \
osc://.*/.*   http://downloads.yoctoproject.org/mirror/sources/ \n \
p4://.*/.*    http://downloads.yoctoproject.org/mirror/sources/ \n \
svn://.*/.*   http://downloads.yoctoproject.org/mirror/sources/ \n"

MIRRORS =+ "\
ftp://.*/.*      http://downloads.yoctoproject.org/mirror/sources/ \n \
http://.*/.*     http://downloads.yoctoproject.org/mirror/sources/ \n \
https://.*/.*    http://downloads.yoctoproject.org/mirror/sources/ \n"

# The CONNECTIVITY_CHECK_URI's are used to test whether we can succesfully
# fetch from the network (and warn you if not). To disable the test set
# the variable to be empty.
# Git example url: git://git.yoctoproject.org/yocto-firewall-test;protocol=git;rev=HEAD

CONNECTIVITY_CHECK_URIS ?= " \
	"
# Default hash policy for distro
BB_SIGNATURE_HANDLER ?= 'OEBasicHash'
#
# OELAYOUT_ABI allows us to notify users when the format of TMPDIR changes in
# an incompatible way. Such changes should usually be detailed in the commit
# that breaks the format and have been previously discussed on the mailing list
# with general agreement from the core team.
#
OELAYOUT_ABI = "8"

# add poky sanity bbclass
INHERIT += "poky-sanity"

#WARN_QA = "unsafe-references-in-binaries unsafe-references-in-scripts"
WARN_QA = ""
ERROR_QA = "debug-deps dev-deps debug-files arch la2 pkgconfig la perms useless-rpaths rpaths staticdev ldflags"
```
